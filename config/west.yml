## config/west.yml
```yaml
manifest:
  remotes:
    - name: snize
      url-base: https://github.com/snize
  projects:
    - name: zmk-seiboku-example
      remote: snize
      revision: main
      import: config/west.yml
  self:
    path: config
```
